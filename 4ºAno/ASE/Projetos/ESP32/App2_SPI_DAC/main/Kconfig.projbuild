## 4ºAno/ASE/Projetos/ESP32/App2_SPI_DAC/main/Kconfig.projbuild
```kconfig
menu "EEPROM Configuration"

	choice MODEL
		prompt "EEPROM MODEL"
		default M95010
		help
			Select EEPROM Chip Model.
		config M95010
			bool "M95010"
			help
				EEPROM is M95010(1K Bit)
		config M95020
			bool "M95020"
			help
				EEPROM is M95020(2K Bit)
		config M95040
			bool "M95040"
			help
				EEPROM is M95040(4K Bit)
		config M95080
			bool "M95080"
			help
				EEPROM is M95080(8K Bit)
		config M95160
			bool "M95160"
			help
				EEPROM is M95160(16K Bit)
		config M95320
			bool "M95320"
			help
				EEPROM is M95320(32K Bit)
		config M95640
			bool "M95640"
			help
				EEPROM is M95640(64K Bit)
		config M95128
			bool "M95128"
			help
				EEPROM is M95128(128K Bit)
		config M95256
			bool "M95256"
			help
				EEPROM is M95256(256K Bit)
		config M95512
			bool "M95512"
			help
				EEPROM is M95512(512K Bit)
		config AT25010
			bool "AT25010"
			help
				EEPROM is AT25010(1K Bit)
		config AT25020
			bool "AT25020"
			help
				EEPROM is AT25020(2K Bit)
		config AT25040
			bool "AT25040"
			help
				EEPROM is AT25040(4K Bit)
		config AT25080
			bool "AT25080"
			help
				EEPROM is AT25080(8K Bit)
		config AT25160
			bool "AT25160"
			help
				EEPROM is AT25160(16K Bit)
		config AT25320
			bool "AT25320"
			help
				EEPROM is AT25320(32K Bit)
		config AT25640
			bool "AT25640"
			help
				EEPROM is AT25640(64K Bit)
		config AT25128
			bool "AT25128"
			help
				EEPROM is AT25128(128K Bit)
		config AT25256
			bool "AT25256"
			help
				EEPROM is AT25256(256K Bit)
		config AT25512
			bool "AT25512"
			help
				EEPROM is AT25512(512K Bit)
	endchoice

	config CS_GPIO
		int "CS GPIO number"
		range 0 34
		default 12 if IDF_TARGET_ESP32
		default 12 if IDF_TARGET_ESP32S2
		default 1  if IDF_TARGET_ESP32C3
		help
			GPIO number (IOxx) to CS.
			Some GPIOs are used for other purposes (flash connections, etc.).
			GPIOs 35-39 are input-only so cannot be used as outputs.

	config SCLK_GPIO
		int "SCLK GPIO number"
		range 0 34
		default 13 if IDF_TARGET_ESP32
		default 13 if IDF_TARGET_ESP32S2
		default 2  if IDF_TARGET_ESP32C3
		help
			GPIO number (IOxx) to SCLK.
			Some GPIOs are used for other purposes (flash connections, etc.).
			GPIOs 35-39 are input-only so cannot be used as outputs.

	config MISO_GPIO
		int "MISO GPIO number"
		range 0 34
		default 14 if IDF_TARGET_ESP32
		default 17 if IDF_TARGET_ESP32S2
		default 9  if IDF_TARGET_ESP32C3
		help
			GPIO number (IOxx) to MISO.
			Some GPIOs are used for other purposes (flash connections, etc.).
			GPIOs 35-39 are input-only so cannot be used as outputs.

	config MOSI_GPIO
		int "MOSI GPIO number"
		range 0 39
		default 15 if IDF_TARGET_ESP32
		default 18 if IDF_TARGET_ESP32S2
		default 10 if IDF_TARGET_ESP32C3
		help
			GPIO number (IOxx) to MOSI.
			Some GPIOs are used for other purposes (flash connections, etc.).
			GPIOs 35-39 are input-only so can be used as inputs.
endmenu
```
